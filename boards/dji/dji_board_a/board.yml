## boards/dji/dji_board_a/board.yml
```yaml
board:
  name: dji_board_a
  full_name: DJI RoboMaster Development Board A
  vendor: DJI
  socs:
    - name: stm32f427xx
```

## boards/dji/dji_board_c/dji_board_c_defconfig
```kconfig
CONFIG_ARM_MPU=y

CONFIG_HW_STACK_PROTECTION=y

CONFIG_SERIAL=y

CONFIG_CONSOLE=y
CONFIG_UART_CONSOLE=y
CONFIG_LOG=y
CONFIG_LOG_MODE_IMMEDIATE=y
CONFIG_PRINTK=y

CONFIG_GPIO=y
CONFIG_LED=y
CONFIG_PWM=y
CONFIG_LED_PWM=y
```
